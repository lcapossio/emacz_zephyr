## Kconfig
```kconfig
# SPDX-License-Identifier: Apache-2.0
# Copyright (c) 2026 Leonardo Capossio - bard0 design

DT_CHOSEN_Z_CONSOLE := zephyr,console

menu "emacz Zephyr app"

config EMACZ_APP_RAW_UART
	bool "emacz app raw UART status output"
	depends on SERIAL && $(dt_chosen_enabled,$(DT_CHOSEN_Z_CONSOLE))
	default y
	help
	  Enable the bring-up application's status prints, polled out on the
	  console UART.
	  Disable this for performance tests that must rule out blocking UART
	  output independently from Zephyr's console and logging settings.

config EMACZ_APP_PAYLOAD_BUF_OFFSET
	int "Byte offset of the UDP sink and TX benchmark buffers"
	range 0 3
	default 0
	help
	  Start the buffers the UDP sink receives into and the TX benchmark
	  sends from this many bytes past a word boundary. A UDP payload
	  starts 42 bytes into its frame, 2 bytes off a word boundary, and
	  the minimal libc memcpy copies word by word only when source and
	  destination share their alignment: 2 lets the socket copies run on
	  words instead of bytes.

config EMACZ_APP_SINK_THREAD_PRIORITY
	int "UDP sink thread priority"
	default -2
	help
	  Zephyr priority of the thread that drains the UDP sink socket.
	  Negative is cooperative: it then runs until its socket is empty,
	  ahead of the control thread (priority 4) that runs the TX
	  benchmark. At 4, with time slicing, the two share the CPU.

config EMACZ_APP_THREAD_USAGE
	bool "Publish per-thread CPU time in the perf stats block"
	select THREAD_RUNTIME_STATS
	select THREAD_MONITOR
	select THREAD_NAME
	help
	  Run a high-priority thread that every 50 ms writes the cycles the
	  driver RX, UDP sink, control, main and system work queue threads and
	  the idle thread have used into the perf stats block, and refreshes
	  the MAC and network-stack counters there, which main otherwise does
	  once a second and not at all while a cooperative RX path holds the
	  CPU. For measurements: it adds 20 wakeups a second.

endmenu
```

## boards/bard0/arty_a7_vex/Kconfig.arty_a7_vex
```kconfig
# SPDX-License-Identifier: Apache-2.0
# Copyright (c) 2026 Leonardo Capossio - bard0 design

config BOARD_ARTY_A7_VEX
	select SOC_ARTY_A7_VEX
```

## boards/bard0/arty_a7_vex/Kconfig.defconfig
```kconfig
# SPDX-License-Identifier: Apache-2.0
# Copyright (c) 2026 Leonardo Capossio - bard0 design

if BOARD_ARTY_A7_VEX

config BOARD
	default "arty_a7_vex"

endif # BOARD_ARTY_A7_VEX
```

## boards/bard0/arty_a7_vex/board.yml
```yaml
board:
  name: arty_a7_vex
  full_name: Arty A7-100T VexRiscv-full
  vendor: bard0
  socs:
    - name: vexriscv_axi
```

## boards/bard0/zcu106_r5/Kconfig.defconfig
```kconfig
# SPDX-License-Identifier: Apache-2.0
# Copyright (c) 2026 Leonardo Capossio - bard0 design

if BOARD_ZCU106_R5

config BOARD
	default "zcu106_r5"

endif # BOARD_ZCU106_R5
```

## boards/bard0/zcu106_r5/board.yml
```yaml
board:
  name: zcu106_r5
  full_name: ZCU106 Cortex-R5 with the emacZero PL shell
  vendor: bard0
  socs:
    - name: zynqmp_rpu
```

## boards/bard0/zcu106_vex/Kconfig.defconfig
```kconfig
# SPDX-License-Identifier: Apache-2.0
# Copyright (c) 2026 Leonardo Capossio - bard0 design

if BOARD_ZCU106_VEX

config BOARD
	default "zcu106_vex"

endif # BOARD_ZCU106_VEX
```

## boards/bard0/zcu106_vex/Kconfig.zcu106_vex
```kconfig
# SPDX-License-Identifier: Apache-2.0
# Copyright (c) 2026 Leonardo Capossio - bard0 design

config BOARD_ZCU106_VEX
	select SOC_VEXRISCV_AXI
```

## boards/bard0/zcu106_vex/board.yml
```yaml
board:
  name: zcu106_vex
  full_name: ZCU106 VexRiscv-full
  vendor: bard0
  socs:
    - name: vexriscv_axi
```

## boards/bard0/zcu106_vex/zcu106_vex_defconfig
```kconfig
# SPDX-License-Identifier: Apache-2.0
# Copyright (c) 2026 Leonardo Capossio - bard0 design

CONFIG_MAIN_STACK_SIZE=2048
CONFIG_CONSOLE=y
CONFIG_SERIAL=y
CONFIG_UART_CONSOLE=y
```

## drivers/Kconfig
```kconfig
# SPDX-License-Identifier: Apache-2.0
# Copyright (c) 2026 Leonardo Capossio - bard0 design

rsource "ethernet/Kconfig"
```

## drivers/ethernet/Kconfig
```kconfig
# SPDX-License-Identifier: Apache-2.0
# Copyright (c) 2026 Leonardo Capossio - bard0 design

menuconfig ETH_EMACZERO
	bool "emacZero Ethernet MAC driver"
	default y
	depends on DT_HAS_BARD0_EMACZERO_ENABLED
	select ETHERNET
	help
	  Enable the Zephyr Ethernet driver for bard0 emacZero. The driver
	  controls the AXI-Lite CSR block, exposes MAC statistics, and can use
	  Xilinx AXI DMA for packet RX/TX when axistream-connected is present.

if ETH_EMACZERO

config ETH_EMACZERO_INIT_PRIORITY
	int "emacZero init priority"
	default 80
	help
	  Device initialization priority for the emacZero Ethernet driver.

config ETH_EMACZERO_PROFILE
	bool "emacZero RX profiling counters"
	help
	  Enable low-overhead counters and cycle accumulators around the
	  emacZero RX DMA callback, RX worker packet construction, and
	  net_recv_data() handoff. The driver also exposes runtime profiling
	  modes that can drop packets after DMA completion or after Zephyr
	  packet construction to isolate bottlenecks without rebuilding.

config ETH_EMACZERO_RX_DIRECT_RING
	bool "emacZero direct AXI DMA S2MM RX descriptor ring"
	depends on ETH_EMACZERO_DMA_MEMORY_SIZE != 0
	help
	  Let the emacZero Ethernet driver own the AXI DMA S2MM scatter/gather
	  descriptor ring directly for RX. This bypasses Zephyr's generic DMA
	  API on the receive hot path while leaving TX on the generic DMA API.
	  The Zephyr Xilinx AXI DMA driver must not install its RX ISR when
	  this option is enabled.

config ETH_EMACZERO_RX_BUFFER_COUNT
	int "emacZero RX DMA buffer count"
	default 64
	range 8 256
	help
	  Number of DMA-visible RX buffers/descriptors allocated by the
	  driver. The generic default is 64 so small BRAM-backed builds keep
	  memory use bounded. The Arty DDR performance app intentionally
	  overrides this to 128 so it can keep 64 RX descriptors posted while
	  retaining free-list slack for Zephyr-owned and copy-fallback buffers.

config ETH_EMACZERO_RX_DMA_POST_COUNT
	int "emacZero posted RX DMA buffer target"
	default 16
	range 1 255
	help
	  Maximum number of RX buffers kept posted to the AXI DMA S2MM channel.
	  Keep this below ETH_EMACZERO_RX_BUFFER_COUNT so the driver retains
	  free-list slack while Zephyr owns received zero-copy buffers.

config ETH_EMACZERO_RX_MAX_STACK_OWNED_ZEROCOPY
	int "emacZero max zero-copy buffers owned by Zephyr"
	default 56
	range 0 255
	help
	  Maximum number of RX buffers that may be handed to Zephyr as
	  external zero-copy net_buf fragments before the driver falls back
	  to copying packets into Zephyr-owned buffers. Set this to 0 for
	  DDR-backed designs that must not hand DMA buffers directly to the
	  Zephyr network stack.

config ETH_EMACZERO_RX_COPY_FALLBACK_COUNT
	int "emacZero packet-sized RX copy fallback buffer count"
	default 32
	range 0 4096
	help
	  Number of packet-sized driver-owned buffers used by the RX copy
	  fallback path. These buffers avoid allocating many small Zephyr
	  net_buf data fragments for each MTU-sized fallback packet.

config ETH_EMACZERO_DMA_MEMORY_BASE
	hex "emacZero DMA-visible memory base"
	default 0x0
	help
	  Base address of a memory window visible to both MicroBlaze V data
	  AXI and the AXI DMA masters. When non-zero, emacZero RX/TX packet
	  buffers and Xilinx AXI DMA SG descriptors are allocated from this
	  window instead of normal kernel RAM. Use this when kernel code/data
	  live in CPU-local LMB that the DMA cannot access.

config ETH_EMACZERO_DMA_MEMORY_SIZE
	hex "emacZero DMA-visible memory size"
	default 0x0
	help
	  Size in bytes of the DMA-visible memory window. A zero size keeps
	  the legacy in-kernel static packet buffers and the Zephyr DMA
	  driver's normal SG descriptor allocation.

config ETH_EMACZERO_SG_MEMORY_BASE
	hex "emacZero AXI DMA scatter-gather descriptor memory base"
	default 0x0
	help
	  Base address of a dedicated memory window (typically an AXI BRAM)
	  used for AXI DMA scatter-gather descriptor rings and the TX/RX BDs.
	  When zero, SG allocations fall back to the general DMA memory pool
	  (ETH_EMACZERO_DMA_MEMORY_BASE).

config ETH_EMACZERO_SG_MEMORY_SIZE
	hex "emacZero AXI DMA scatter-gather descriptor memory size"
	default 0x0
	help
	  Size in bytes of the SG descriptor memory window. Set to non-zero
	  when the hardware has a dedicated BRAM on the AXI DMA M_AXI_SG
	  port, keeping small descriptor transactions off DDR.

config ETH_EMACZERO_R7_INSTRUMENTATION
	bool "emacZero per-region cycle instrumentation (R7)"
	depends on ETH_EMACZERO_PROFILE
	help
	  Enable per-region cycle accumulators inside the RX hot path so a host
	  tool can attribute per-packet wall time to individual driver regions
	  (ISR, spinlocks, ready-fifo enqueue, release/refill, tail CSR write,
	  RX-thread build). The counters land in the perf-stats block behind a
	  "PRF2" magic word so host tools can locate them by scan. Cost is a
	  handful of k_cycle_get_32() reads per packet — off by default.

config ETH_EMACZERO_DCACHE_MAINT
	bool "Emit RISC-V fence + Zicbom cbo.clean/inval for DMA coherency"
	default y
	help
	  Emit fence + cbo.clean/cbo.inval instructions in the DMA cache
	  maintenance helpers so descriptor and buffer memory stays coherent
	  between the CPU D-cache and the AXI DMA engine. Disable this on
	  RISC-V cores whose decoder does not accept the standard fence /
	  Zicbom encodings (e.g., the VexRiscv-full demo config used by the
	  bard0 arty_a7_vex shell); the maintenance calls then become no-ops
	  and DMA coherency must be ensured by placing descriptor rings and
	  DMA buffers in an uncached memory region.

endif
```

## dts/bindings/ethernet/bard0,emaczero.yaml
```yaml
# SPDX-License-Identifier: Apache-2.0
# Copyright (c) 2026 Leonardo Capossio - bard0 design

---
description: bard0 emacZero Ethernet MAC

compatible: "bard0,emaczero"

include: ethernet-controller.yaml

properties:
  reg:
    required: true

  interrupts:
    required: false

  phy-handle:
    type: phandle
    description: Optional PHY node controlled through emacZero MDIO.

  axistream-connected:
    type: phandle
    description: Xilinx AXI DMA connected to emacZero packet streams.

  link-speed:
    type: int
    default: 100
    enum:
      - 10
      - 100
      - 1000
    description: Initial fixed link speed in Mbit/s.
```

## soc/bard0/arty_a7_vex/Kconfig.soc
```kconfig
# SPDX-License-Identifier: Apache-2.0
# Copyright (c) 2026 Leonardo Capossio - bard0 design

config SOC_ARTY_A7_VEX
	bool
	select RISCV
	help
	  VexRiscv-full soft CPU on Arty A7-100T (bard0 emacz_zephyr).

config SOC
	default "arty_a7_vex" if SOC_ARTY_A7_VEX
```

## soc/bard0/vexriscv_axi/Kconfig.soc
```kconfig
# SPDX-License-Identifier: Apache-2.0
# Copyright (c) 2026 Leonardo Capossio - bard0 design

config SOC_VEXRISCV_AXI
	bool
	select RISCV
	help
	  VexRiscv-full soft CPU with AXI4 buses, an AXI INTC and a RISC-V
	  machine timer, as built by the bard0 emacz_zephyr hardware shells
	  (Arty A7-100T, ZCU106).

config SOC
	default "vexriscv_axi" if SOC_VEXRISCV_AXI
```

## tests/app_build/testcase.yaml
```yaml
# SPDX-License-Identifier: Apache-2.0
# Copyright (c) 2026 Leonardo Capossio - bard0 design

tests:
  emacz.app.build:
    build_only: true
    platform_allow: mbv32
    integration_platforms:
      - mbv32
    tags:
      - build
      - net
      - drivers
```

## west.yml
```yaml
# SPDX-License-Identifier: Apache-2.0
# Copyright (c) 2026 Leonardo Capossio - bard0 design

---
manifest:
  self:
    path: emacz_zephyr
  projects:
    - name: zephyr
      url: https://github.com/Xilinx/zephyr-amd
      path: deps/zephyr
      revision: xlnx_rel_v2026.1
      import: true
```
