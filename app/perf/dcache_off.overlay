/*
 * SPDX-License-Identifier: Apache-2.0
 * Copyright (c) 2026 Leonardo Capossio - bard0 design
 *
 * Cache-off measurement variant for the soft-CPU boards (mbv32,
 * arty_a7_vex, zcu106_vex): Zephyr's RAM moves above the D-cache aperture
 * (0x9000_0000-0x97FF_FFFF on both CPUs), so every data access goes to
 * memory. Instruction fetch stays cached: the VexRiscv I-cache caches every
 * fetch, and the MicroBlaze V one covers 0x9000_0000-0x9FFF_FFFF. The DMA
 * window at 0x9F00_0000 is unchanged. Load the image with
 * load_zephyr_bram.py --addr 0x98000000, which writes a jump there at the
 * CPU's 0x9000_0000 entry.
 */

/delete-node/ &ram0;

/ {
	ram0: memory@98000000 {
		device_type = "memory";
		reg = <0x98000000 0x07000000>;
	};

	chosen {
		zephyr,sram = &ram0;
	};
};
